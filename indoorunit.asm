INDOOR UNIT:
ORG 0000H
LJMP MAIN
ORG 0013H
ACALL IX1
RETI
ORG 0023H
LJMP SERIAL
ORG 0030H
MAIN: ;R0, R1, R2, R3, R4, R7-encryp key
MOV IE, #10010100B
SETB TCON.0
MOV TMOD, #21H
MOV TH1, #-3D ; 9600 baud rate
MOV SCON, #50H
SETB TR1
MOV R0, #30H ; starting address of the incoming byte - 1
MOV R2, #05H ; number of bytes
MOV IP, #00000100B ; External interrupt 1 will have higher priority
MOV P1, #0FFH
MOV R1, #40H
CLR P2.0
; STORING THE VALUE OF THE KEY IN 20H
MOV 40H, #'Q' ; QWERT, 12345, abcde are passwords
MOV 41H, #'W'
MOV 42H, #'E'
MOV 43H, #'R'
MOV 44H, #'T'
MOV 45H, #'a'
MOV 46H, #'b'
MOV 47H, #'c'
MOV 48H, #'d'
MOV 49H, #'e'
MOV 4AH, #'1' ;pra is the password
MOV 4BH, #'2'
MOV 4CH, #'3'
MOV 4DH, #'4'
MOV 4EH, #'5'
MOV R7, #77H
LJMP HERE ; to bypass the search program at the start
; SEARCH PROGRAM
SEARCH:
MOV R0, #30H ; starting address of the entered key
MOV R2, #05H
MOV R5, #40H
MOV R6, #03H
MOV R1, #40H
LSEARCH:
MOV A, @R0
XRL A, R7 ;decrypting the data
SUBB A, @R1
JNZ NEXT
INC R0
INC R1
DJNZ R2, LSEARCH
ACALL OPEN
SJMP EXIT
; add code to check against multiple keys
NEXT:
MOV A, R5
ADD A, #05H
MOV R5, A
MOV R1, A
MOV R0, #30H
MOV R2, #05H
DJNZ R6, LSEARCH
EXIT:
MOV R0, #30H
MOV R1, #40H
MOV R2, #05H
; SEARCH PROGRAM ENDS
CLR P2.0
HERE:
JB P2.7, SKIP
ACALL OPEN
SKIP:
CJNE R2, #00H, HERE
SJMP SEARCH
SERIAL:
MOV A, SBUF
MOV @R0, A
INC R0
DEC R2
CLR RI
RETI
IX1: ; Door is open
SETB TR0
JNB TF0, JUMP
CLR TR0
CLR TF0
INC R4
CJNE R4, #50D, JUMP
SETB P2.0
JUMP:
JNB P3.3, IX1
CLR TR0
CLR P2.0
MOV R3, #01H ; To cut short delay if called in the middle of the delay
MOV TH0, #0FH
MOV TL0, #0FH
MOV R4, #00H
SETB TR0
RET
OPEN:
CLR IE.4
NOP
NOP
NOP
NOP
NOP
CLR P2.6 ; Pause U1
CLR P2.1
MOV R3, #35D ; Using R0 register to loop
REPEAT:
MOV TH0, #00H
MOV TL0, #00H
SETB TR0
LOOP: JNB TF0, LOOP
CLR TR0
CLR TF0
DJNZ R3, REPEAT
CLR P2.0
SETB P2.1
CLR TR0
CLR TF0
; change key
CLR IE.7
MOV A, R7
ADD A, #05H
MOV R7, A
MOV R4, #15D
LS: NOP
DJNZ R4, LS
MOV R4, #00H
SETB P2.6
SETB IE.7
SETB IE.4
RET
