; P0.0 GOES TO RX INTERPT
; p2 is for LCD DATA
; P1.0 RS
; P1.1 R/W
; P1.2 E
ORG 0000H
LJMP MAIN
ORG 0023H
LJMP SERIAL
ORG 0003H
ACALL IX0
RETI
ORG 0030H
MAIN: ;R0, R1, R7
SETB TCON.0
MOV IP, #00000001B
MOV TMOD, #21H
MOV TH1, #-3D ; 9600 baud rate
MOV SCON, #50H
SETB TR1
MOV TH0, #00H
MOV TL0, #00H
MOV P2, #00H ; making p2 as an output port
MOV P1, #0f0H
MOV A, #38H ;INIT
ACALL LCD_COMMAND
MOV A, #0EH
ACALL LCD_COMMAND
ACALL LCD_LOCK
READY:
MOV R0, #30H ; Temp address for storing the received key
MOV R1, #05H
MOV R7, #77H ; ENCRY KEY
MOV IE, #10010001B
POLL:
CJNE R1, #00H, POLL
CLR IE.7 ; All bits are received from RFID 
MOV R0, #30H
MOV R1, #05H
SEND:
MOV A, @R0
XRL A, R7 ; Encrypting r7
MOV SBUF, A
CLR TI
HERE: JNB TI, HERE
INC R0
DJNZ R1, SEND
MOV R0, #30H
MOV R1, #05H
CLR TI
SETB IE.7
SJMP POLL
SERIAL:
MOV A, SBUF
MOV @R0, A
INC R0
DEC R1
CLR P1.7
RETI
IX0:
CLR P1.6
MOV A, #01H
ACALL LCD_COMMAND
MOV A, #02H
ACALL LCD_COMMAND
ACALL LCD_OPEN
IX0L:
JNB P3.2, IX0L
MOV A, R7
ADD A, #05H
MOV R7, A
MOV A, #01H
ACALL LCD_COMMAND
MOV A, #02H
ACALL LCD_COMMAND
ACALL LCD_LOCK
MOV R0, #30H
MOV R1, #05H
RET
LCD_COMMAND:
MOV P2, A
CLR P1.0 ;CLR RS
CLR P1.1 ;WRITE MODE
SETB P1.2 
ACALL LCD_DELAY
CLR P1.2
ACALL LCD_DELAY
RET
LCD_DATA:
MOV P2, A
SETB P1.0 ;SET RS
CLR P1.1 ;WRITE MODE
SETB P1.2 
ACALL LCD_DELAY
CLR P1.2
ACALL LCD_DELAY
RET
LCD_LOCK:
MOV A, #'D'
ACALL LCD_DATA
MOV A, #'O'
ACALL LCD_DATA
MOV A, #'O'
ACALL LCD_DATA
MOV A, #'R'
ACALL LCD_DATA
MOV A, #' '
ACALL LCD_DATA
MOV A, #'L'
ACALL LCD_DATA
MOV A, #'O'
ACALL LCD_DATA
MOV A, #'C'
ACALL LCD_DATA
MOV A, #'K'
ACALL LCD_DATA
MOV A, #'E'
ACALL LCD_DATA
RET
LCD_OPEN:
MOV A, #'D'
ACALL LCD_DATA
MOV A, #'O'
ACALL LCD_DATA
MOV A, #'O'
ACALL LCD_DATA
MOV A, #'R'
ACALL LCD_DATA
MOV A, #' '
ACALL LCD_DATA
MOV A, #'O'
ACALL LCD_DATA
MOV A, #'P'
ACALL LCD_DATA
MOV A, #'E'
ACALL LCD_DATA
MOV A, #'N'
ACALL LCD_DATA
RET
LCD_DELAY:
MOV TH0, #0FDH
MOV TL0, #00H
SETB TR0
LLD: JNB TF0, LLD
CLR TR0
CLR TF0
RET
